/*
 * RockChip. LCD_B101ew05
 *
 */

/ {

		disp_timings: display-timings {
                        native-mode = <&timing0>;
                        timing0: timing0 {
				screen-type = <SCREEN_RGB>;
				lvds-format = <LVDS_8BIT_2>;
				out-face    = <OUT_D888_P666>;
				clock-frequency = <54000000>;
				hactive = <1024>;
				vactive = <600>;
				hback-porch = <180>;
				hfront-porch = <160>;
				vback-porch = <30>;
				vfront-porch = <26>;
				hsync-len = <1>;
				vsync-len = <1>;
				hsync-active = <0>;
				vsync-active = <0>;
				de-active = <0>;
				pixelclk-active = <1>;
				swap-rb = <0>;
				swap-rg = <0>;
				swap-gb = <0>;
                     	};
               };
};
